## config/boards/shields/nice_view_github/Kconfig.defconfig
```kconfig
# Copyright (c) 2023 The ZMK Contributors
# SPDX-License-Identifier: MIT

if SHIELD_NICE_VIEW_GITHUB

config LS0XX_VCOM_THREAD_PRIO
    default 11

config LV_Z_VDB_SIZE
    default 100

config LV_DPI_DEF
    default 161

config LV_Z_BITS_PER_PIXEL
    default 1

choice LV_COLOR_DEPTH
    default LV_COLOR_DEPTH_1
endchoice

choice ZMK_DISPLAY_WORK_QUEUE
    default ZMK_DISPLAY_WORK_QUEUE_DEDICATED
endchoice

choice ZMK_DISPLAY_STATUS_SCREEN
    default ZMK_DISPLAY_STATUS_SCREEN_CUSTOM
endchoice

config LV_Z_MEM_POOL_SIZE
    default 12288

config ZMK_DISPLAY_STATUS_SCREEN_CUSTOM
    select LV_FONT_MONTSERRAT_16
    select LV_USE_IMAGE
    select LV_USE_CANVAS

endif
```
